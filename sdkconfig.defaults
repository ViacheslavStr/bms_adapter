## sdkconfig.defaults
```kconfig
# Bluetooth configuration
CONFIG_BT_ENABLED=y
CONFIG_BT_BLUEDROID_ENABLED=y
CONFIG_BT_NIMBLE_ENABLED=n
CONFIG_BT_CONTROLLER_ENABLED=y
CONFIG_BT_BLE_ENABLED=y
CONFIG_BT_CLASSIC_ENABLED=n

# Flash size (2MB для вашей платы)
CONFIG_ESPTOOLPY_FLASHSIZE_2MB=y
CONFIG_ESPTOOLPY_FLASHSIZE="2MB"

# Bluetooth memory settings
CONFIG_BT_ALLOCATION_FROM_SPIRAM_FIRST=n
CONFIG_BT_BLE_DYNAMIC_ENV_MEMORY=y

# Enable BLE 4.2 features (required for esp_ble_gattc_open)
CONFIG_BT_BLE_42_FEATURES_SUPPORTED=y

# Enable BLE 4.2 scanning (required for esp_ble_gap_set_scan_params)
CONFIG_BT_BLE_42_SCAN_EN=y
```
